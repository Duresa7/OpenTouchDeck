## firmware/components/td_radio/Kconfig
```kconfig
menu "TouchDeck radio build"

    # No prompt: the option is on exactly when this component is in the build, which only -DTD_RADIO_BUILD=1 does.
    config TD_RADIO_BUILD
        bool
        default y
        help
            Set in the radio build, which has Wi-Fi, lwIP and NimBLE. The normal build does not have this
            component, so the option does not exist there, and the radio guards fail any normal build that has it.

    config TD_RADIO_INTERNAL_FLOOR
        int "Internal RAM the radio build keeps free in steady state, in bytes"
        range 24576 131072
        default 24576
        help
            The display, the render tasks and the perf task need internal RAM. With the Wi-Fi station started, the
            radio build logs an error when less than this is free once it reaches steady state, and `radio state`
            reports floor_ok false. It also reports floor_ok false while the station is not started. The radio
            guard fails a build that sets it below 24576.

    config TD_RADIO_BOOT_FLOOR
        int "Internal RAM the radio build keeps free through boot, in bytes"
        range 16384 131072
        default 16384
        help
            The lowest free internal RAM since startup, ESP-IDF's minimum free size, which `heap` reports as
            min_free_internal. Boot is when it dips: the Wi-Fi station's start takes about 19 KB at once. With the
            station started, the steady-state report logs an error when the minimum is below this, and `radio state`
            reports boot_floor_ok false. ESP-IDF counts the 32 KB internal pool it reserves after startup
            (CONFIG_SPIRAM_MALLOC_RESERVE_INTERNAL) with a minimum of 0, so the figure leaves that pool out and real
            headroom is larger. The radio guard fails a build that sets it below 16384.

    config TD_QEMU_TEST
        bool "QEMU test image: Ethernet in place of Wi-Fi, and a pairing window opened at boot"
        default n
        help
            Only `idf.py -DTD_QEMU_TEST=1` sets this, for CI's QEMU check of net-v2 over TCP. The image starts QEMU's
            emulated Ethernet instead of the Wi-Fi station, skips the panel, touch and USB console that QEMU lacks,
            opens a pairing window at boot and logs its code. firmware/tools/radio_guard.py fails any other build
            that has it. Never flash it to a Device.

    config TD_RADIO_STEADY_MS
        int "Time from radio start to the steady-state heap report, in milliseconds"
        range 1000 600000
        default 30000

endmenu
```
